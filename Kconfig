## Kconfig
```kconfig
#
# For a description of the syntax of this configuration file,
# see the file kconfig-language.txt in the NuttX tools repository.
#

config EXAMPLES_REFLOW
	tristate "Reflow example"
	default n
	---help---
		Enable the example

if EXAMPLES_REFLOW

config EXAMPLES_REFLOW_PROGNAME
	string "Program name"
	default "reflow"
	---help---
		This is the name of the program that will be used when the NSH ELF
		program is installed.

config EXAMPLES_REFLOW_PRIORITY
	int "Task priority"
	default 100

config EXAMPLES_REFLOW_STACKSIZE
	int "Stack size"
	default DEFAULT_TASK_STACKSIZE

endif
```
